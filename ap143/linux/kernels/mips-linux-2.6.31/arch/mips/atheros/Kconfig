## ap143/linux/kernels/mips-linux-2.6.31/arch/mips/atheros/Kconfig
```kconfig
#
# USB device configuration
#

menu "TP-LINK GPIO Setting Support"
	depends on MACH_QCA953x

config GPIO_DEBUG
	bool "GPIO DEBUG turn on/off"
	default n if MACH_QCA953x
	default n
	
menu "JumpStart LED"
config GPIO_JUMPSTART_LED_BIT
	int "JumpStart LED Bit"
	range -1 17
	default 3 if MACH_QCA953x
	default 3

config GPIO_JUMPSTART_LED_ON
	int "Jump Start LED's value Of On"
	range 0 1
	default 0 if MACH_QCA953x
	default 0
endmenu

menu "Ready Status"
config GPIO_READY_STATUS_BIT
	int "Ready Status Led Bit"
	range -1 17
	default -1 if MACH_QCA953x
	default -1

config GPIO_READY_STATUS_ON
	int "Ready Status Led's value of On"
	range 0 1
	default 0 if MACH_QCA953x
	default 0
endmenu

menu "USB(TMS) LED"
config GPIO_USB_LED_BIT
	int "USB(TMS) LED bit"
	range -1 22
	default -1 if MACH_QCA953x
	default -1

config GPIO_USB_LED_ON
	int "GPIO USB Led's value of On"
	range 0 1
	default 0 if MACH_QCA953x
	default 0
endmenu

menu "USB Switch for 3G"
config GPIO_USB_SWITCHFOR3G_BIT
	int "USB Switch for 3G bit"
	range -1 22
	default -1 if MACH_QCA953x
	default -1
endmenu

menu "Reset Factory Default"
config GPIO_RESET_FAC_BIT
	int "Reset Factory Default bit"
	range -1 18
	default 12 if MACH_QCA953x
	default 12

config GPIO_FAC_RST_HOLD_TIME
	int "Reset Key Hold Time for Factory Default"
	range 1 15
	default 5
endmenu

menu "JumpStart Switch"
config GPIO_JUMPSTART_SW_BIT
	int "JumpStart Switch bit"
	range -1 17
	default -1 if MACH_QCA953x
	default -1
endmenu

menu "WiFi Radio Switch"
config GPIO_WIFI_SWITCH_BIT
	int "WiFi Radio Switch bit"
	range -1 22
	default 17 if MACH_QCA953x
	default 17
	
config GPIO_WIFI_BUTTON_HOLD_TIME
	int "Reset Key Hold Time for Wifi Button"
	range 1 15
	default 2
	
endmenu

menu "Work Mode Switch"
config GPIO_WORKMODE_SWITCH_1ST_BIT
	int "Work Mode Switch (1st step)"
	range -1 22
	default -1 if MACH_QCA953x
	default -1

config GPIO_WORKMODE_SWITCH_2ND_BIT
	int "Work Mode Switch (2nd step)"
	range -1 22
	default -1 if MACH_QCA953x
	default -1
endmenu

menu "Internet LED"
config GPIO_INTERNET_LED_BIT
	int "Internet LED bit"
	range -1 22
	default -1 if MACH_QCA953x
	default -1

config GPIO_INTERNET_LED_ON
	int "GPIO Internet Led's value of On"
	range 0 1
	default 0 if MACH_QCA953x
	default 0
endmenu

menu "WiFi Signal Strength LED"
config GPIO_WIFI_SIGNAL_LED1_BIT
	int "WiFi Signal Strength LED-1 bit"
	range -1 22
	default -1 if MACH_QCA953x
	default -1

config GPIO_WIFI_SIGNAL_LED1_ON
	int "WiFi Signal Strength LED-1's value of On"
	range 0 1
	default 0 if MACH_QCA953x
	default 0

config GPIO_WIFI_SIGNAL_LED2_BIT
	int "WiFi Signal Strength LED-2 bit"
	range -1 22
	default -1 if MACH_QCA953x
	default -1

config GPIO_WIFI_SIGNAL_LED2_ON
	int "WiFi Signal Strength LED-2's value of On"
	range 0 1
	default 0 if MACH_QCA953x
	default 0

config GPIO_WIFI_SIGNAL_LED3_BIT
	int "WiFi Signal Strength LED-3 bit"
	range -1 22
	default -1 if MACH_QCA953x
	default -1

config GPIO_WIFI_SIGNAL_LED3_ON
	int "WiFi Signal Strength LED-3's value of On"
	range 0 1
	default 0 if MACH_QCA953x
	default 0

config GPIO_WIFI_SIGNAL_LED4_BIT
	int "WiFi Signal Strength LED-4 bit"
	range -1 22
	default -1 if MACH_QCA953x
	default -1

config GPIO_WIFI_SIGNAL_LED4_ON
	int "WiFi Signal Strength LED-4's value of On"
	range 0 1
	default 0 if MACH_QCA953x
	default 0

config GPIO_WIFI_SIGNAL_LED5_BIT
	int "WiFi Signal Strength LED-5 bit"
	range -1 22
	default -1 if MACH_QCA953x
	default -1

config GPIO_WIFI_SIGNAL_LED5_ON
	int "WiFi Signal Strength LED-5's value of On"
	range 0 1
	default 0 if MACH_QCA953x
	default 0
endmenu

endmenu
```
